## Kconfig
```kconfig
menu "Google IoT Core Configuration"

config GIOT_PROJECT_ID
    string "Google Cloud Project ID"
    default "project_id"
    help
        Google Cloud project ID

config GIOT_LOCATION
    string "Google Cloud location"
    default "us-central1-a"
    help
        Google Cloud region

config GIOT_REGISTRY_ID
    string "Google IoT Core Registry ID"
    default "registry_id"
    help
        Google IoT Core registry id

config GIOT_DEVICE_ID
    string "Google IoT Core Device ID"
    default "device_id"
    help
        Google IoT Core device id

config GIOT_DEBUG_OUTPUT
    bool "Enable debugging"
    help
        Select this option to enable debugging support

config IOTC_MEMORY_LIMITER_APPLICATION_MEMORY_LIMIT
    int "Google IoT Core Application Memory Limit"
    default 524288
    help
        Set application memory limit for Google IoT Core

config IOTC_MEMORY_LIMITER_SYSTEM_MEMORY_LIMIT
    int "Google IoT Core System Memory Limit"
    default 2024
    help
        Set system memory limit for Google IoT Core

config IOTC_IO_BUFFER_SIZE
    int "Google IoT Core IO Buffer Size"
    default 32
    help
        Set Google IoT Core IO buffer size

config IOTC_BACKOFF_CHECK_TIME
    int "Google IoT Core Backoff Check Time"
    default 60
    help
        Set Google IoT Core backoff check time

config IOTC_MQTT_MAX_PAYLOAD_SIZE
    int "Google IoT Core MQTT Max Payload Size"
    default 131072
    help
        Set Google IoT Core max size for MQTT payloads

config IOTC_DEFAULT_IDLE_TIMEOUT
    int "Google IoT Core Default Idle Timeout"
    default 1
    help
        Set Google IoT Core default idle timeout

config IOTC_MAX_IDLE_TIMEOUT
    int "Google IoT Core Max Idle Timeout"
    default 5
    help
        Set Google IoT Core max idle timeout

config IOTC_MQTT_PORT
    int "Google IoT Core MQTT Port"
    default 8883
    help
        Set Google IoT Core MQTT port. Insecure connections usually use 1883

config IOTC_MQTT_HOST
    string "Google IoT MQTT Host"
    default "mqtt.2030.ltsapis.goog"
    help
        Set Google IoT Core MQTT Host
endmenu
```

## examples/mqtt_logic_producer_esp32/main/Kconfig.projbuild
```kconfig
menu "Example Configuration"

config ESP_WIFI_SSID
    string "WiFi SSID"
    default "myssid"
    help
	SSID (network name) for the example to connect to.

config ESP_WIFI_PASSWORD
    string "WiFi Password"
    default "mypassword"
    help
	WiFi password (WPA or WPA2) for the example to use.

config PROJECT_ID
    string "Google Cloud Project ID"
    default "project_id"
    help 
    Google Cloud project ID

config DEVICE_PATH
    string "Google Cloud Device path"
    default "device_path"
    help 
    projects/<project-id>/locations/<registry-location>/registries/<registry-id>/devices/<device-id>

endmenu
```

## examples/smart_outlet/main/Kconfig.projbuild
```kconfig
menu "Example Configuration"

config ESP_WIFI_SSID
    string "WiFi SSID"
    default "myssid"
    help
	SSID (network name) for the example to connect to.

config ESP_WIFI_PASSWORD
    string "WiFi Password"
    default "mypassword"
    help
	WiFi password (WPA or WPA2) for the example to use.

config OUTPUT_GPIO
    int "Output GPIO"
    default 27
    help
    This is the GPIO on which output will be set.

endmenu
```
